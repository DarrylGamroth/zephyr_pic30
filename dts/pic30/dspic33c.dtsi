/*
 * Copyright (c) 2020 Rubus Technologies Inc.
 *
 * SPDX-License-Identifier: Apache-2.0
 */

#include "skeleton.dtsi"

/ {
	soc {
		#address-cells = <1>;
		#size-cells = <1>;
		compatible = "simple-bus";
		interrupt-parent = <&intc>;
		ranges;

		intc: interrupt-controller@800  {
			compatible = "microchip,pic30-intc";
			reg = <0x800 0xc8>;
			interrupt-controller;
			#interrupt-cells = <2>;
		};

		timer1: timer@100 {
			compatible = "microchip,pic30-timer1";
			reg = <0x000100 0x008>;
			status = "disabled";
		};
	};
};
