/*
 * Copyright (c) 2020 Rubus Technologies Inc.
 *
 * SPDX-License-Identifier: Apache-2.0
 */

/dts-v1/;
#include <microchip/dspic33fjxxxgpxx10a.dtsi>

/ {
	model = "Microchip Explorer16";
	compatible = "dspic33f,explorer16", "microchip,dspic33fj256gp701a", "microchip,dspic33f";
};

