/*
 * Copyright (c) 2020 Rubus Technologies Inc.
 *
 * SPDX-License-Identifier: Apache-2.0
 */

/dts-v1/;

#include <dspic33c/33ck256mp508.dtsi>

/ {
	model = "Microchip DM330030 dsPIC33CK Curiosity";
	compatible = "dspic33c,dm330030", "microchip,dspic33ck256mp508";

	chosen {
		zephyr,console = &uart1;
		zephyr,shell-uart = &uart1;
		zephyr,sram = &sram0;
		zephyr,flash = &flash0;
	};
};

&cpu0 {
	clock-frequency = <200000000>;
};

&uart1 {
	current-speed = <115200>;
	status = "okay";
};

