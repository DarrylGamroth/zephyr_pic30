/*
 * Copyright (c) 2020 Rubus Technologies Inc.
 *
 * SPDX-License-Identifier: Apache-2.0
 */

&spi2 {
	cs-gpios = <&gpio0 22 0>;
	adxl355@0 {
		compatible = "adi,adxl355";
		reg = <0>;
		spi-max-frequency = <8000000>;
		label = "ADXL355";
		int1-gpios = <&gpio0 11 GPIO_ACTIVE_HIGH>;
	};
};
