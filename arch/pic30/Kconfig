## arch/pic30/Kconfig
```kconfig
# PIC30 architecture configuration options

# Copyright (c) 2020 Rubus Technologies Inc.
# SPDX-License-Identifier: Apache-2.0

menu "PIC30 Options"
	depends on PIC30

config ARCH
	default "pic30"

#
# CPU Families - the SoC configuration should select the right one.
#

config CPU_PIC24E
	bool
	help
	  This option signifies the use of a CPU from the PIC24E family.

config CPU_PIC24F
	bool
	help
	  This option signifies the use of a CPU from the PIC24F family.

config CPU_PIC24H
	bool
	help
	  This option signifies the use of a CPU from the PIC24H family.

config CPU_DSPIC33C
	bool
	help
	  This option signifies the use of a CPU from the dsPIC33C family.

config CPU_DSPIC33E
	bool
	help
	  This option signifies the use of a CPU from the dsPIC33E family.

config CPU_DSPIC33F
	bool
	help
	  This option signifies the use of a CPU from the dsPIC33F family.

config DYNAMIC_DIRECT_INTERRUPTS
	bool "Enable support for dynamic direct interrupts"
	depends on DYNAMIC_INTERRUPTS
	help
	  Direct interrupts are designed for performance-critical interrupt
	  handling and do not go through all of the common interrupt handling
	  code. This option enables the installation of interrupt service
	  routines for direct interrupts at runtime.
	  Note: this requires enabling support for dynamic interrupts in the
	  kernel.

config FAULT_DUMP
	int "Fault dump level"
	default 2
	range 0 2
	help
	  Different levels for display information when a fault occurs.

	  2: The default. Display specific and verbose information. Consumes
		the most memory (long strings).

	  1: Display general and short information. Consumes less memory
		(short strings).

	  0: Off.

config ZERO_LATENCY_IRQS
	bool "Enable zero-latency interrupts"
	default y
	help
	  The kernel may reserve some of the highest interrupts priorities in
	  the system for its own use. These interrupts will not be masked
	  by interrupt locking.
	  When connecting interrupts the kernel will offset all interrupts
	  to lower priority than those reserved by the kernel.
	  Zero-latency interrupt can be used to set up an interrupt at the
	  highest interrupt priority which will not be blocked by interrupt
	  locking.
	  Since Zero-latency ISRs will run in the same priority or possibly at
	  higher priority than the rest of the kernel they cannot use any
	  kernel functionality.

config GEN_ISR_TABLES
	default y

config GEN_IRQ_VECTOR_TABLE
	default n

config GEN_IRQ_START_VECTOR
	default 0

config NUM_IRQS
	int

endmenu
```

## boards/pic30/dm330030/Kconfig.board
```kconfig
#
# Copyright (c) 2020 Rubus Technologies Inc.
#
# SPDX-License-Identifier: Apache-2.0
#

config BOARD_DM330030
	bool "Microchip DM330030 dsPIC33CK Curiosity"
	depends on SOC_PIC33CK256MP508
```

## boards/pic30/dm330030/Kconfig.defconfig
```kconfig
# Microchip DM330030 board configuration

# Copyright (c) 2020 Rubus Technologies Inc.
# SPDX-License-Identifier: Apache-2.0

config BOARD
	default "dm330030"
	depends on BOARD_DM330030
```

## boards/pic30/dm330030/dm330030_defconfig
```kconfig
# SPDX-License-Identifier: Apache-2.0
CONFIG_SOC_SERIES_DSPIC33C=y
CONFIG_SOC_PART_NUMBER_DSPIC33CK256MP508=y
CONFIG_BOARD_DM330030=y
CONFIG_CONSOLE=n
CONFIG_SERIAL=n
```

## boards/pic30/explorer16/Kconfig.board
```kconfig
#
# Copyright (c) 2020 Rubus Technologies Inc.
#
# SPDX-License-Identifier: Apache-2.0
#

config BOARD_EXPLORER16
	bool "Microchip Explorer16 Board"
	depends on SOC_DSPIC33F
```

## boards/pic30/explorer16/Kconfig.defconfig
```kconfig
# Explorer16 board configuration

# Copyright (c) 2020 Rubus Technologies Inc.
# SPDX-License-Identifier: Apache-2.0

if BOARD_EXPLORER16

config BOARD
	default "explorer16"

endif
```

## cmake/toolchain/xc16/Kconfig
```kconfig
# Microchip XC16 Toolchain

# Copyright (c) 2020 Rubus Technologies Inc.
# SPDX-License-Identifier: Apache-2.0

config TOOLCHAIN_XC16
	def_bool n
	select HAS_NEWLIB_LIBC_NANO
```

## drivers/interrupt_controller/Kconfig.pic30
```kconfig
# PIC30 INTC configuration

# Copyright (c) 2020 Rubus Technologies Inc.
# SPDX-License-Identifier: Apache-2.0

if PIC30

config PIC30_INTC
	bool "Interrupt Controller for PIC30 family of processors"
	default y if PIC30
	help
	  The Microchip PIC30 Interrupt Controller works with the
	  dsPIC33/PIC24 enhanced core processors.

endif # SOC_FAMILY_PIC30
```

## dts/bindings/cpu/microchip,dspic33c.yaml
```yaml
# Copyright (c) 2020 Rubus Technologies Inc.
# SPDX-License-Identifier: Apache-2.0

description: Microchip dsPIC33C CPU

compatible: "microchip,dspic33c"

include: cpu.yaml
```

## dts/bindings/cpu/microchip,dspic33e.yaml
```yaml
# Copyright (c) 2020 Rubus Technologies Inc.
# SPDX-License-Identifier: Apache-2.0

description: Microchip dsPIC33E CPU

compatible: "microchip,dspic33e"

include: cpu.yaml
```

## dts/bindings/cpu/microchip,dspic33f.yaml
```yaml
# Copyright (c) 2020 Rubus Technologies Inc.
# SPDX-License-Identifier: Apache-2.0

description: Microchip dsPIC33F CPU

compatible: "microchip,dspic33f"

include: cpu.yaml
```

## dts/bindings/flash_controller/microchip,dspic33ep-flash-controller.yaml
```yaml
description: dsPIC33EP Family flash controller

compatible: "microchip,dspic33ep-flash-controller.yaml"

include: flash-controller.yaml
```

## dts/bindings/interrupt-controller/microchip,33e-intc.yaml
```yaml
description: Microchip dsPIC33E interrupt controller

compatible: "microchip,33e-intc"

include: [interrupt-controller.yaml, base.yaml]

properties:
    reg:
      required: true

    microchip,num-irq-priority-bits:
      required: true
      type: int
      description: number of bits of IRQ priorities

    "#interrupt-cells":
      const: 2

interrupt-cells:
  - irq
  - priority
```

## dts/bindings/interrupt-controller/microchip,pic30-intc.yaml
```yaml
description: Microchip PIC30 interrupt controller

compatible: "microchip,pic30-intc"

include: [interrupt-controller.yaml, base.yaml]

properties:
    reg:
      required: true

    microchip,num-irq-priority-bits:
      required: true
      type: int
      description: number of bits of IRQ priorities

    "#interrupt-cells":
      const: 2

interrupt-cells:
  - irq
  - priority
```

## dts/bindings/sensor/adi,adxl355-spi.yaml
```yaml
# Copyright (c) 2020 Analog Devices Inc.
# Copyright (c) 2018 Analog Devices Inc.
# SPDX-License-Identifier: Apache-2.0

description: ADXL355 3-axis accelerometer, accessed through SPI bus

compatible: "adi,adxl355"

include: spi-device.yaml

properties:
    int1-gpios:
      type: phandle-array
      required: false
      description: |
        The INT1 signal defaults to active high as produced by the
        sensor.  The property value should ensure the flags properly
        describe the signal that is presented to the driver.
```

## dts/bindings/serial/microchip,pic30-uart.yaml
```yaml
description: Microchip pic30 UART

compatible: "microchip,pic30-uart"

include: uart-controller.yaml

properties:
    reg:
      required: true
```

## dts/bindings/timer/microchip,pic30-timer1.yaml
```yaml
# Copyright (c) 2020 Rubus Technologies Inc.
# SPDX-License-Identifier: Apache-2.0

description: Microchip PIC30 Timer1

compatible: "microchip,pic30-timer1"

include: base.yaml

properties:
    reg:
      required: true

    interrupts:
      required: true

    label:
      required: true

    prescaler:
      type: int
      required: false
      description: Timer prescaler
      enum:
        - 1
        - 8
        - 64
        - 256
```

## samples/sensor/adxl355/sample.yaml
```yaml
sample:
  name: ADXL355 3-Axis Accelerometer Sensor
tests:
  sample.sensor.adxl355:
    harness: sensor
    tags: sensors
    depends_on: spi
    platform_whitelist: atsame54_xpro
  sample.sensor.adxl355.i2c:
    harness: sensor
    tags: sensors
    depends_on: i2c
    platform_whitelist: atsame54_xpro
    extra_args: "CONF_FILE=prj_i2c.conf"
```

## soc/pic30/Kconfig
```kconfig
# General options signifying CPU capabilities of PIC30 SoCs

# Copyright (c) 2020 Rubus Technologies Inc.
# SPDX-License-Identifier: Apache-2.0

config SOC_PART_NUMBER
	string
	help
	  This string holds the full part number of the SoC. It is a hidden option
	  that you should not set directly. The part number selection choice defines
	  the default value for this string.
```

## soc/pic30/Kconfig.defconfig
```kconfig
# Microchip pic30 MCU family default configuration options

# Copyright (c) 2020 Rubus Technologies Inc.
# SPDX-License-Identifier: Apache-2.0

source "soc/pic30/*/Kconfig.defconfig.series"
```

## soc/pic30/Kconfig.soc
```kconfig
# Microchip pic30 MCU series selection

# Copyright (c) 2020 Rubus Technologes Inc.
# SPDX-License-Identifier: Apache-2.0

source "soc/pic30/*/Kconfig.series"
```

## soc/pic30/common/Kconfig.defconfig.series
```kconfig
# Microchip PIC30

# Copyright (c) 2020 Rubus Technologies Inc.
# SPDX-License-Identifier: Apache-2.0

# Here are set all the Kconfig symbols common to the whole PIC30 family

if SOC_FAMILY_PIC30

config UART_PIC30
	default y
	depends on SERIAL

if GPIO

config GPIO_PIC30
	default y

endif # GPIO

config PINMUX_PIC30
	default y
	depends on PINMUX

config PWM_PIC30
	default y
	depends on PWM

config SPI_PIC30
	default y
	depends on SPI

config ADC_PIC30
	default y
	depends on ADC

if DMA

config DMA_PIC30
	default y

config HEAP_MEM_POOL_SIZE
	default 256

endif # DMA

endif # SOC_FAMILY_PIC30
```

## soc/pic30/dspic/Kconfig
```kconfig
# Microchip DSPIC MCU family configuration options

# Copyright (c) 2020 Rubus Technologies Inc.
# SPDX-License-Identifier: Apache-2.0

config SOC_FAMILY_DSPIC
	bool

if SOC_FAMILY_DSPIC

config SOC_FAMILY
	string
	default "dspic"

source "soc/pic30/dspic/*/Kconfig.soc"

endif
```

## soc/pic30/dspic/Kconfig.defconfig
```kconfig
# SPDX-License-Identifier: Apache-2.0

source "soc/pic30/dspic/*/Kconfig.defconfig.series"
```

## soc/pic30/dspic/Kconfig.soc
```kconfig
# Copyright (c) 2020 Rubus Technologies Inc.
# SPDX-License-Identifier: Apache-2.0

source "soc/pic30/dspic/*/Kconfig.series"
```
