## soc/pic30/dspic/dspic33c/Kconfig.defconfig.series
```kconfig
# Microchip dsPIC33C MCU series configuration options

# Copyright (c) 2020 Rubus Technologies Inc.
# SPDX-License-Identifier: Apache-2.0

if SOC_SERIES_DSPIC33C

config SOC_SERIES
	string
	default "dspic33c"

config SOC_PART_NUMBER
	string
	default "33ck256mp508" if SOC_PART_NUMBER_DSPIC33CK256MP508

config NUM_IRQS
	int
	default 196 if SOC_PART_NUMBER_DSPIC33CK256MP508

config SYS_CLOCK_HW_CYCLES_PER_SEC
	int
	default 200000000

endif # SOC_SERIES_DSPIC33C
```

## soc/pic30/dspic/dspic33c/Kconfig.soc
```kconfig
# Microchip dsPIC33C MCU series

# Copyright (c) 2020 Rubus Technologies Inc.
# SPDX-License-Identifier: Apache-2.0

choice
	prompt "Microchip dsPIC33C MCU Selection"
	depends on SOC_SERIES_DSPIC33C

config SOC_PART_NUMBER_DSPIC33CK256MP508
	bool "DSPIC33CK256MP508"

endchoice
```

## soc/pic30/dspic33c/Kconfig.defconfig
```kconfig
# Microchip dsPIC33C MCU series configuration options

# Copyright (c) 2020 Rubus Technologies Inc.
# SPDX-License-Identifier: Apache-2.0

if SOC_SERIES_DSPIC33C

source "soc/pic30/dspic33c/Kconfig.defconfig.dspic33c*"

config SOC_SERIES
	default "dspic33c"

config NUM_IRQS
	default 254

endif # SOC_SERIES_DSPIC33C
```

## soc/pic30/dspic33f/Kconfig.defconfig.series
```kconfig
# Microchip dsPIC33F MCU series configuration options

# Copyright (c) 2020 Rubus Technologies Inc.
# SPDX-License-Identifier: Apache-2.0

if SOC_SERIES_DSPIC33F

config SOC_SERIES
	default "dspic33f"

config SOC
	default "33fj256gp710a" if SOC_DSPIC33FJ256GP710A
	default "33fj128mc804" if SOC_DSPIC33FJ128MC804

config NUM_IRQS
	default 126

config SYS_CLOCK_HW_CYCLES_PER_SEC
	default 48000000

endif # SOC_SERIES_DSPIC33F
```

## soc/pic_back/Kconfig
```kconfig
# Microchip pic30 MCU family configuration options

# Copyright (c) 2020 Rubus Technologies Inc.
# SPDX-License-Identifier: Apache-2.0

config SOC_FAMILY_PIC30
	bool
	select BUILD_OUTPUT_HEX

if SOC_FAMILY_PIC30

config SOC_FAMILY
	string
	default "pic30"

source "soc/pic30/*/Kconfig.soc"

endif
```

## soc/pic_back/common/Kconfig.defconfig.series
```kconfig
# Microchip PIC30 MCU family configuration options

# Copyright (c) 2020 Rubus Technologies Inc.
# SPDX-License-Identifier: Apache-2.0

if SOC_FAMILY_PIC30

config ADC_PIC30
	default ADC

config COUNTER_PIC30_TC32
	default COUNTER

config DMA_PIC30
	default DMA

config GPIO_PIC30
	default GPIO

config HWINFO_PIC30
	default HWINFO

config I2C_PIC30
	default I2C

config PINMUX_PIC30
	default PINMUX

config PWM_PIC30_TCC
	default PWM

config SPI_PIC30
	default SPI

config UART_PIC30
	default SERIAL

config WDT_PIC30
	default WATCHDOG

endif # SOC_FAMILY_PIC30
```

## soc/pic_back/dspic33c/Kconfig.defconfig.dspic33ck256mp508
```kconfig
# Microchip dsPIC33C MCU series configuration options

# Copyright (c) 2020 Rubus Technologies Inc.
# SPDX-License-Identifier: Apache-2.0

config SOC
	default "33ck256mp502" if SOC_DSPIC33CK256MP502
	default "33ck256mp504" if SOC_DSPIC33CK256MP504
	default "33ck256mp508" if SOC_DSPIC33CK256MP508

config SYS_CLOCK_HW_CYCLES_PER_SEC
	default 200000000
```

## soc/pic_back/dspic33c/Kconfig.series
```kconfig
# Microchip dsPIC33C MCU series

# Copyright (c) 2020 Rubus Technologies Inc.
# SPDX-License-Identifier: Apache-2.0

config SOC_SERIES_DSPIC33C
	bool "Microchip dsPIC33C MCU"
	select PIC30
	select CPU_DSPIC33C
	select SOC_FAMILY_DSPIC33C
	help
	  Enable support for Microchip dsPIC33C microcontrollers.
```

## soc/pic_back/dspic33f/Kconfig.defconfig.dspic33fj256gp710a
```kconfig
# Microchip dsPIC33F MCU series configuration options

# Copyright (c) 2020 Rubus Technologies Inc.
# SPDX-License-Identifier: Apache-2.0

if SOC_DSPIC33FJ256GP710A

config SOC
	default "33fj256gp710a" if SOC_DSPIC33FJ256GP710A

config SYS_CLOCK_HW_CYCLES_PER_SEC
	default 48000000

endif
```

## soc/pic_back/dspic33f/Kconfig.defconfig.series
```kconfig
# Microchip dsPIC33F MCU series configuration options

# Copyright (c) 2020 Rubus Technologies Inc.
# SPDX-License-Identifier: Apache-2.0

if SOC_SERIES_DSPIC33F

source "soc/pic30/dspic33f/Kconfig.defconfig.dspic33f*"

config SOC_SERIES
	default "dspic33f"

config NUM_IRQS
	default 126

endif # SOC_SERIES_DSPIC33F
```

## soc/pic_back/dspic33f/Kconfig.series
```kconfig
# Microchip dsPIC33F MCU series

# Copyright (c) 2020 Rubus Technologies Inc.
# SPDX-License-Identifier: Apache-2.0

config SOC_SERIES_DSPIC33F
	bool "Microchip dsPIC33F MCU"
	select PIC30
	select CPU_DSPIC33F
	select SOC_FAMILY_DSPIC33F
	help
	  Enable support for Microchip dsPIC33F microcontrollers.
```

## soc/pic_back/dspic33f/Kconfig.soc
```kconfig
# Microchip dsPIC33F MCU series

# Copyright (c) 2020 Rubus Technologies Inc.
# SPDX-License-Identifier: Apache-2.0

choice
	prompt "Microchip dsPIC33F MCU Selection"
	depends on SOC_SERIES_DSPIC33F

config SOC_DSPIC33FJ256GP710A
	bool "dspic33fj256gp710a"

config SOC_DSPIC33FJ128MC804
	bool "dspic33fj128mc804"

endchoice
```
